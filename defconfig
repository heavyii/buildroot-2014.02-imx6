## defconfig
```kconfig
BR2_arm=y
BR2_cortex_a9=y
BR2_ARM_ENABLE_NEON=y
BR2_ARM_FPU_VFPV3=y
BR2_KERNEL_HEADERS_3_0=y
BR2_TOOLCHAIN_BUILDROOT_LARGEFILE=y
BR2_TOOLCHAIN_BUILDROOT_INET_IPV6=y
BR2_TOOLCHAIN_BUILDROOT_INET_RPC=y
BR2_TOOLCHAIN_BUILDROOT_WCHAR=y
BR2_TOOLCHAIN_BUILDROOT_CXX=y
BR2_PACKAGE_HOST_GDB=y
BR2_TARGET_GENERIC_HOSTNAME="dlrc"
BR2_TARGET_GENERIC_ISSUE="Welcome to dlrc"
BR2_TARGET_GENERIC_GETTY_PORT="ttymxc0"
BR2_ROOTFS_OVERLAY="board/dlrc/imx6/rootfs"
BR2_LINUX_KERNEL=y
BR2_LINUX_KERNEL_CUSTOM_TARBALL=y
BR2_LINUX_KERNEL_CUSTOM_TARBALL_LOCATION="board/dlrc/imx6/tarball/linux-3.0.35-gpu-4.1.0-wand.tar.bz2"
BR2_LINUX_KERNEL_USE_CUSTOM_CONFIG=y
BR2_LINUX_KERNEL_CUSTOM_CONFIG_FILE="board/dlrc/imx6/linuxconfig"
BR2_PACKAGE_BUSYBOX_CONFIG="board/dlrc/imx6/busyboxconfig"
BR2_TARGET_UBOOT=y
BR2_TARGET_UBOOT_BOARDNAME="snapgate"
BR2_TARGET_UBOOT_CUSTOM_TARBALL=y
BR2_TARGET_UBOOT_CUSTOM_TARBALL_LOCATION="board/dlrc/imx6/tarball/u-boot-2013.10.tar.bz2"
BR2_TARGET_UBOOT_FORMAT_IMX=y
```
